AUTOSAR XML (schema 00049)
package /AUTOSAR
  module definition Fee [0..1]: variants pre-compile  # Configuration of the Fee (Flash EEPROM Emulation) module.
    container FeeGeneral  # Container for general parameters. These parameters are not specific to a block.
      boolean FeeDevErrorDetect: set at pre-compile, default-value=false  # Switches the development error detection and notification on or off. | * true: detection and notification is enabled. * false: detection and notification is disabled.
      float FeeMainFunctionPeriod: 0..INF, scope=ECU, set at pre-compile, default-value=0.01  # The period between successive calls to the main function in seconds.
      function name FeeNvmJobEndNotification [0..1]: multiplicity set at pre-compile, set at pre-compile, default-value=NvM_JobEndNotification  # Mapped to the job end notification routine provided by the upper layer module (NvM_JobEndNotification).
      function name FeeNvmJobErrorNotification [0..1]: multiplicity set at pre-compile, set at pre-compile, default-value=NvM_JobErrorNotification  # Mapped to the job error notification routine provided by the upper layer module (NvM_JobErrorNotification).
      boolean FeePollingMode: set at pre-compile  # Pre-processor switch to enable and disable the polling mode for this module. | true: Polling mode enabled, callback functions (provided to FLS module) disabled. false: Polling mode disabled, callback functions (provided to FLS module) enabled.
      boolean FeeSetModeSupported: set at pre-compile  # Compiler switch to enable/disable the 'SetMode' functionality of the FEE module. | TRUE: SetMode functionality supported / code present, FALSE: SetMode functionality not supported / code not present. Note: This configuration setting has to be consistent with that of all underlying flash device drivers (configuration parameter FlsSetModeApi).
      boolean FeeVersionInfoApi: set at pre-compile, default-value=false  # Pre-processor switch to enable / disable the API to read out the modules version information. | true: Version info API enabled. false: Version info API disabled.
      integer FeeVirtualPageSize: 0..65535, set at pre-compile, default-value=8  # The size in bytes to which logical blocks shall be aligned.
      string FeeUserCbkHeaderFile [0..*]: multiplicity set at pre-compile, set at pre-compile, default-value=#include "NvM_Cbk.h", max-length=32, min-length=1  # The header file of the callback function declares.
      boolean FeeCancelApi: set at pre-compile  # Whether to enable the job cancellation mechanism.
      string FeeInitErrorNotification [0..1]: scope=ECU, set at pre-compile, symbolic-name-value=true  # Fee module initialization failed callback function.
      boolean FeePageDirectWriteSupport: set at pre-compile  # Whether to support direct write without erasing.
      container FeeBank [0..*]
        integer FeeBankIndex: 0..65535, scope=ECU, set at pre-compile, symbolic-name-value=true  # The bank identifier in the Fee module
        integer FeeBankStartaddress: 0..4294967295, scope=ECU, set at pre-compile, symbolic-name-value=true  # The bank start address
        integer FeeBankSize: 0..4294967295, scope=ECU, set at pre-compile, symbolic-name-value=true  # The bank size
        reference FeeBankRef [0..1]: set at link in variant link-time+post-build / pre-compile in variant pre-compile, destination=FlsSector  # The FlsSector in the flash driver associated with Fee bank
    container FeeBlockConfiguration [1..*]  # Configuration of block specific parameters for the Flash EEPROM Emulation module.
      integer FeeBlockNumber: 1..65534, scope=ECU, set at pre-compile, symbolic-name-value=true, default-value=0  # Block identifier (handle). | 0x0000 and 0xFFFF shall not be used for block numbers (see FEE006). Range: min = 2^NVM_DATASET_SELECTION_BITS max = 0xFFFF -2^NVM_DATASET_SELECTION_BITS Note: Depending on the number of bits set aside for dataset selection several other block numbers shall also be left out to ease implementation.
      integer FeeBlockSize: 1..65535, scope=ECU, set at pre-compile  # Size of a logical block in bytes.
      boolean FeeImmediateData: scope=ECU, set at pre-compile  # Marker for high priority data. | true: Block contains immediate data. false: Block does not contain immediate data.
    container FeePublishedInformation  # Additional published parameters not covered by CommonPublishedInformation container. | Note that these parameters do not have any configuration class setting, since they are published information.
      integer FeeBlockOverhead: 0..65535, set at published-information  # Management overhead per logical block in bytes. | Note: If the management overhead depends on the block size or block location a formula has to be provided that allows the configurator to calculate the management overhead correctly.
      integer FeeBankOverhead: 0..65535, set at published-information  # Management overhead per bank in bytes. | Note: If the management overhead depends on the block size or block location a formula has to be provided that allows the configurator to calculate the management overhead correctly.
