AUTOSAR XML (schema 4-2-2)
package /AUTOSAR
  module definition Det [0..1]: variants pre-compile  # Det configuration includes the functions to be called at notification. On one side the application functions are specified and in general it can be decided whether Dlt shall be called at each call of Det.
    container DetGeneral  # Generic configuration parameters of the Det module.
      boolean DetForwardToDlt: set at pre-compile, default-value=false  # Only if the parameter is present and set to true, the Det requires the Dlt interface and forwards it's call to the function Dlt_DetForwardErrorTrace. In this case the optional interface to Dlt_Det is required.
      boolean DetVersionInfoApi: set at pre-compile, default-value=false  # This configuration parameter is used to switch on or to switch off the API to get the version information. Pre-processor switch to enable / disable the API to read out the modules version information.
      boolean DetErrorHookEnabled: set at pre-compile, default-value=false  # Pre-processor switch to enable / disable, the Functional used to call error hook when an error is reported.
      boolean DetRuntimeErrorCalloutEnabled: set at pre-compile, default-value=false  # Pre-processor switch to enable / disable, the Functional used to perform callout when an runtime error is reported.
      boolean DetTransientFaultCalloutEnabled: set at pre-compile, default-value=false  # Pre-processor switch to enable / disable, the Functional used to perform callout when an transient fault is reported.
    container DetNotification [0..1]  # Configuration of the notification functions.
      enumeration DetErrorHook [0..*]: set at pre-compile  # Optional list of functions to be called by the Default Error Tracer in context of each call of Det_ReportError. The type of these functions shall be identical the type of Det_ReportError itself: Std_ReturnType (*f)(uint16, uint8, uint8, uint8).
      enumeration DetReportRuntimeErrorCallout [0..*]: set at pre-compile  # This parameter defines the existence and the names of callout functions for the corresponding runtime error handler. The type of these functions shall be identical the type of Det_ReportRuntimeError itself: Std_ReturnType (*f)(uint16, uint8, uint8, uint8).
      enumeration DetReportTransientFaultCallout [0..*]: set at pre-compile  # This parameter defines the existence and the names of callout functions for the corresponding transient fault handler. The type of these functions shall be identical the type of Det_ReportTransientFault itself: Std_ReturnType (*f)(uint16, uint8, uint8, uint8) .
    container DetConfigSet [0..1]  # Configuration set container for Det.
