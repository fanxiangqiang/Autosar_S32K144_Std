AUTOSAR XML (schema 4-2-2)
package /AUTOSAR
  module definition FlsTst [0..1]: post-build-variant-support=true, variants post-build/pre-compile
    container FlsTstGeneral
      boolean FlsTstDevErrorDetect: set at pre-compile, default-value=true  # Switches the development error detection and notification on or off. | * true: detection and notification is enabled. * false: detection and notification is disabled.
      float FlsTstMainFunctionPeriod: 0..INF, scope=ECU, set at pre-compile, default-value=1  # Determines the frequency at which the FlsTstMainFunction is called in [s].
      integer FlsTstNumberOfTestedCells [0..1]: 1..4294967295, set at pre-compile, default-value=1  # Configures the Number of cells to be tested in background mode during one scheduled task (FlsTst_MainFunction() call).
      integer FlsTstNumberOfTestedCellsAtomic: 1..4294967295, set at pre-compile, default-value=128  # Configures the Number of cells to be tested in background mode without checking user requests (Abort, Suspend).
      boolean FlsTstTestCompletedNotificationSupported: set at pre-compile, default-value=true  # Switch to indicate that the notification is supported.
      integer FlsTstTestIntervalIdEndValue: 1..4294967295, set at pre-compile, default-value=256  # Defines the end value of the Test Interval Id.
      boolean FlsTstInitECC: set at pre-compile, default-value=false  # Enable/Disable the ECC initial function in FlsTst_Init.
      boolean FlsTstExtendedSafetyMode: set at pre-compile, default-value=false  # Enable/Disable the extended safety mechanism.
      integer FlsTstFgndTimeOut [0..1]: 1..4294967295, set at pre-compile, default-value=4294967295  # Define timeout in foreground tests
      reference FlsTstEcucPartitionRef [0..1]: scope=ECU, multiplicity set at pre-compile, post-build-variant-multiplicity=true, post-build-variant-value=true, set at pre-compile, destination=EcucPartition  # Maps the Flash test driver to zero or one ECUC partition to make the driver API available in this partition.
    container FlsTstConfigSet  # This container contains the configuration parameters and sub containers of the AUTOSAR FlsTst module.
      function name FlsTstTestCompletedNotification: post-build-variant-value=true, set at post-build in variant post-build / pre-compile in variant pre-compile, default-value=NULL_PTR  # Pointer to function, which shall be called after finishing the background Flash test interval.
      container FlsTstBlockBgnd [0..*]  # This container specifies configuration parameters for an individual background test block.
        integer FlsTstBgndBlockId: 0..4294967295, set at pre-compile, symbolic-name-value=true  # Blcok ID of flash block in background.
        integer FlsTstBlockBaseAddress: 0..18446744073709551615, post-build-variant-value=true, set at post-build in variant post-build / pre-compile in variant pre-compile  # Start Address of the Flash block.
        integer FlsTstBlockSize: 1..4294967295, post-build-variant-value=true, set at post-build in variant post-build / pre-compile in variant pre-compile  # This parameter shall represent the Flash Test block size.
        integer FlsTstSignatureAddress: 0..18446744073709551615, post-build-variant-value=true, set at post-build in variant post-build / pre-compile in variant pre-compile  # Address of the signature reference value of the Flash test block.
        enumeration FlsTstTestAlgorithm: {FLSTST_16BIT_CRC, FLSTST_32BIT_CRC, FLSTST_8BIT_CRC, FLSTST_CHECKSUM, FLSTST_DUPLICATED_MEMORY, FLSTST_ECC}, post-build-variant-value=true, set at post-build in variant post-build / pre-compile in variant pre-compile  # This is the configuration of the test algorithm. The availability of algorithm is implementation specific.
      container FlsTstBlockFgnd [0..*]  # This container specifies configuration parameters for an individual foreground test block.
        integer FlsTstFgndBlockId: 0..4294967295, set at pre-compile, symbolic-name-value=true  # Blcok ID of flash block in background.
        integer FlsTstBlockBaseAddress: 0..18446744073709551615, post-build-variant-value=true, set at post-build in variant post-build / pre-compile in variant pre-compile  # Start Address of the Flash block.
        integer FlsTstBlockSize: 1..4294967295, post-build-variant-value=true, set at post-build in variant post-build / pre-compile in variant pre-compile  # This parameter shall represent the Flash Test block size.
        integer FlsTstSignatureAddress: 0..18446744073709551615, post-build-variant-value=true, set at post-build in variant post-build / pre-compile in variant pre-compile  # Address of the signature reference value of the Flash test block.
        enumeration FlsTstTestAlgorithm: {FLSTST_16BIT_CRC, FLSTST_32BIT_CRC, FLSTST_8BIT_CRC, FLSTST_CHECKSUM, FLSTST_DUPLICATED_MEMORY, FLSTST_ECC}, post-build-variant-value=true, set at post-build in variant post-build / pre-compile in variant pre-compile  # This is the configuration of the test algorithm. The availability of algorithm is implementation specific.
    container FlsTstConfigurationOfOptApiServices
      boolean FlsTstGetCurrentStateApi: set at pre-compile, default-value=false  # Adds / removes the service FlsTst_GetCurrentState() from the code.
      boolean FlsTstGetErrorDetailsApi: set at pre-compile, default-value=false  # Adds / removes the service FlsTst_GetErrorDetails() from the code.
      boolean FlsTstGetTestResultBgndApi: set at pre-compile, default-value=false  # Adds / removes the service FlsTst_GetTestResultBgnd() from the code.
      boolean FlsTstGetTestResultFgndApi: set at pre-compile, default-value=false  # Adds / removes the service FlsTst_GetTestResultFgnd() from the code.
      boolean FlsTstGetTestSignatureBgndApi: set at pre-compile, default-value=false  # Adds / removes the service FlsTst_GetTestSignatureBgnd() from the code.
      boolean FlsTstGetTestSignatureFgndApi: set at pre-compile, default-value=false  # Adds / removes the service FlsTst_GetTestSignatureFgnd() from the code.
      boolean FlsTstStartFgndApi: set at pre-compile, default-value=false  # Adds / removes the service FlsTst_StartFgnd() from the code.
      boolean FlsTstSuspendResumeApi: set at pre-compile, default-value=false  # Adds / removes the services FlsTst_Suspend() and FlsTst_Resume() from the code.
      boolean FlsTstTestEccApi: set at pre-compile, default-value=false  # Adds / removes the service FlsTst_TestEcc() from the code.
      boolean FlsTstVersionInfoApi: set at pre-compile, default-value=false  # Adds / removes the service FlsTst_GetVersionInfo() from the code.
    container FlsTstDemEventParameterRefs [0..1]  # Container for the references to DemEventParameter elements which shall be invoked using the API Dem_SetEventStatus in case the corresponding error occurs. The EventId is taken from the referenced DemEventParameter's DemEventId symbolic value. The standardized errors are provided in this container and can be extended by vendor-specific error references.
      reference FLSTST_E_FLSTST_FAILURE [0..1]: multiplicity set at pre-compile, set at pre-compile, requires-symbolic-name-value=true, destination=DemEventParameter  # Reference to the DemEventParameter which shall be issued when the error "Flash Failure" has occurred.
