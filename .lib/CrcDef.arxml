AUTOSAR XML (schema 4-2-2)
package /AUTOSAR
  module definition Crc [0..1]: variants pre-compile  # Configuration of the Crc (Crc routines) module.
    container CrcGeneral  # General configuration of CRC module
      boolean AlgorithmCrc8: multiplicity set at pre-compile, set at pre-compile, default-value=true  # CRC8 (SAE J1850) algorithm calculation switch. | true: enabled false: disabled
      boolean AlgorithmCrc8H2F: multiplicity set at pre-compile, set at pre-compile, default-value=false  # Crc8H2F algorithm calculation switch. | true: enabled false: disabled
      boolean AlgorithmCrc16: multiplicity set at pre-compile, set at pre-compile, default-value=false  # CRC16 (CCITT) algorithm calculation switch. | true: enabled false: disabled
      boolean AlgorithmCrc32: multiplicity set at pre-compile, set at pre-compile, default-value=false  # CRC32 (Ethernet) algorithm calculation switch. | true: enabled false: disabled
      boolean AlgorithmCrc32P4: multiplicity set at pre-compile, set at pre-compile, default-value=false  # CRC32 (0xF4ACFB13 polynomial) algorithm calculation switch. | true: enabled false: disabled
      boolean AlgorithmCrc64: multiplicity set at pre-compile, set at pre-compile, default-value=false  # Switches the Crc64 ON or OFF. true: enabled (ON).false: disabled (OFF). | true: enabled false: disabled
      enumeration Crc8Mode: {CRC_HARDWARE, CRC_RUNTIME, CRC_TABLE}, multiplicity set at pre-compile, set at pre-compile, default-value=CRC_TABLE  # Switch to select one of the available CRC 8-bit (SAE J1850) calculation methods
      enumeration Crc8H2FMode: {CRC_HARDWARE, CRC_RUNTIME, CRC_TABLE}, multiplicity set at pre-compile, set at pre-compile, default-value=CRC_TABLE  # Switch to select one of the available CRC 8-bit (2Fh polynomial) calculation methods
      enumeration Crc16Mode: {CRC_HARDWARE, CRC_RUNTIME, CRC_TABLE}, multiplicity set at pre-compile, set at pre-compile, default-value=CRC_TABLE  # Switch to select one of the available CRC 16-bit (CCITT) calculation methods
      enumeration Crc32Mode: {CRC_HARDWARE, CRC_RUNTIME, CRC_TABLE}, multiplicity set at pre-compile, set at pre-compile, default-value=CRC_TABLE  # Switch to select one of the available CRC 32-bit (IEEE-802.3 CRC32 Ethernet Standard) calculation methods.
      enumeration Crc32P4Mode: {CRC_HARDWARE, CRC_RUNTIME, CRC_TABLE}, multiplicity set at pre-compile, set at pre-compile, default-value=CRC_TABLE  # Switch to select one of the available CRC 32-bit E2E Profile 4 calculation methods
      enumeration Crc64Mode: {CRC_HARDWARE, CRC_RUNTIME, CRC_TABLE}, multiplicity set at pre-compile, set at pre-compile, default-value=CRC_TABLE  # Switch to select one of the available CRC 64-bit calculation methods.
