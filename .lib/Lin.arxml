AUTOSAR XML (schema 4-2-2)
package /AUTOSAR
  module definition Lin [0..*]: post-build-variant-support=true, variants post-build/pre-compile  # Configuration of the Lin (LIN driver) module.
    container CommonPublishedInformation  # Container for the references to DemEventParameter elements which shall be invoked using the API Dem_ReportErrorStatus API in case the corresponding error occurs. The EventId is taken from the referenced DemEventParameter's DemEventId value. The standardized errors are provided in the container and can be extended by vendor specific error references.
      integer ArMajorVersion: 0..255, set at pre-compile  # Specifies the InstanceId of this module instance. If only one instance is present it shall have the Id 0.
      integer ArMinorVersion: 0..255, set at pre-compile  # Specifies the InstanceId of this module instance. If only one instance is present it shall have the Id 0.
      integer ArPatchVersion: 0..255, set at pre-compile  # Specifies the maximum number of loops for blocking function until a timeout is raised in short term wait loops
      integer ModuleId: 0..255, set at pre-compile  # Specifies the maximum number of loops for blocking function until a timeout is raised in short term wait loops
      string Release [0..*]: scope=ECU, multiplicity set at pre-compile, set at pre-compile, max-length=32, min-length=1  # Defines header files for callback functions which shall be included in case of CDDs. Range of characters is 1.. 32.
      integer SwMajorVersion: 0..255, set at pre-compile  # Specifies the maximum number of loops for blocking function until a timeout is raised in short term wait loops
      integer SwMinorVersion: 0..255, set at pre-compile  # Specifies the maximum number of loops for blocking function until a timeout is raised in short term wait loops
      integer SwPatchVersion: 0..255, set at pre-compile  # Specifies the maximum number of loops for blocking function until a timeout is raised in short term wait loops
      string VendorApiInfix [0..*]: scope=ECU, multiplicity set at pre-compile, set at pre-compile, max-length=32, min-length=1  # Defines header files for callback functions which shall be included in case of CDDs. Range of characters is 1.. 32.
      integer VendorId: 0..255, set at pre-compile  # Specifies the maximum number of loops for blocking function until a timeout is raised in short term wait loops
    container LinGeneral  # This container contains the parameters related to each LIN Driver Unit.
      enumeration LinCsrClksel: {ASCLINS}, scope=ECU, post-build-variant-value=true, set at link in variant link-time+post-build / pre-compile in variant pre-compile, default-value=ASCLINS
      boolean LinDevErrorDetect: set at pre-compile  # Switches the Default Error Tracer (Det) detection and notification ON or OFF. | * true: enabled (ON). * false: disabled (OFF).
      boolean LinHwMcuTrigSleepEnable: set at pre-compile  # Switches the Default Error Tracer (Det) detection and notification ON or OFF. | * true: enabled (ON). * false: disabled (OFF).
      integer LinIndex: 0..255, set at pre-compile  # Specifies the InstanceId of this module instance. If only one instance is present it shall have the Id 0.
      enumeration LinInitDeInitApiMode: {LIN_MCAL_SUPERVISOR}, scope=ECU, post-build-variant-value=true, set at link in variant link-time+post-build / pre-compile in variant pre-compile, default-value=LIN_MCAL_SUPERVISOR
      boolean LinInterruptDisabled: set at pre-compile  # Switches the Default Error Tracer (Det) detection and notification ON or OFF. | * true: enabled (ON). * false: disabled (OFF).
      integer LinTimeoutDuration: 0..65535, set at pre-compile  # Specifies the maximum number of loops for blocking function until a timeout is raised in short term wait loops
      boolean LinVersionInfoApi: set at pre-compile  # Switches the Lin_GetVersionInfo function ON or OFF.
      symbolic name reference LinSysClockRef: scope=ECU, set at link in variant link-time+post-build / pre-compile in variant pre-compile, destination=McuClockReferencePointConfig  # Reference to the channel definition in the LIN driver.
    container LinGlobalConfig  # This container contains the global configuration parameter of the Lin driver.
      container LinChannel [1..*]  # This container contains the configuration (parameters) of the LIN Controller(s).
        boolean LinAutoCalcBaudParams: set at pre-compile  # Specifies if the LIN hardware channel supports wake up functionality
        enumeration LinChanAssignedHw: {ASCLIN1, ASCLIN2}, scope=ECU, post-build-variant-value=true, set at link in variant link-time+post-build / pre-compile in variant pre-compile, default-value=ASCLIN1
        integer LinChannelBaudDenominator: 0..65535, post-build-variant-value=true, set at post-build in variant post-build / pre-compile in variant pre-compile  # Specifies the baud rate of the LIN channel
        integer LinChannelBaudNumerator: 0..65535, set at pre-compile, symbolic-name-value=true  # Identifies the LIN channel. Replaces LIN_CHANNEL_INDEX_NAME from the LIN SWS.
        integer LinChannelBaudPreScalar: 0..65535, set at pre-compile, symbolic-name-value=true  # Identifies the LIN channel. Replaces LIN_CHANNEL_INDEX_NAME from the LIN SWS.
        integer LinChannelBaudRate: 0..65535, set at pre-compile, symbolic-name-value=true  # Identifies the LIN channel. Replaces LIN_CHANNEL_INDEX_NAME from the LIN SWS.
        integer LinChannelId: 0..65535, set at pre-compile, symbolic-name-value=true  # Identifies the LIN channel. Replaces LIN_CHANNEL_INDEX_NAME from the LIN SWS.
        boolean LinChannelWakeupSupport: set at pre-compile  # Specifies if the LIN hardware channel supports wake up functionality
        integer LinInterByteSpace: 0..65535, set at pre-compile, symbolic-name-value=true  # Identifies the LIN channel. Replaces LIN_CHANNEL_INDEX_NAME from the LIN SWS.
        enumeration LinRxAlternateInputSignal: {SELECT_C_PORT02_PIN10, SELECT_G_PORT02_PIN3}, scope=ECU, post-build-variant-value=true, set at link in variant link-time+post-build / pre-compile in variant pre-compile, default-value=SELECT_C_PORT02_PIN10
        reference LinClockRef: post-build-variant-value=true, set at post-build in variant post-build / pre-compile in variant pre-compile, destination=LinClockRef  # Reference to the LIN clock source configuration, which is set in the MCU driver configuration.
