AUTOSAR XML (schema 4-2-2)
package /AUTOSAR
  module definition Pwm [0..*]: post-build-variant-support=true, variants post-build/pre-compile  # Configuration of Pwm (Pulse Width Modulation) module.
    container PwmGeneral
      boolean PwmDevErrorDetect: set at pre-compile  # Switches the Default Error Tracer (Det) detection and notification ON or OFF. | * true: enabled (ON). * false: disabled (OFF).
      boolean PwmChannelCoherentSelection: set at pre-compile  # Switch for enabling the update of the period / duty parameter at the end of the current period channel wise. Switching on this parameter obsoletes PwmDutycycleUpdatedEndperiod and PwmPeriodUpdatedEndperiod. | * true: enabled (ON). * false: disabled (OFF).
      boolean PwmDutycycleUpdatedEndperiod: set at pre-compile  # Switch for enabling the update of the duty cycle parameter at the end of the current period. | TRUE: update of duty cycle is done at the end of period of currently generated waveform (current waveform is finished). FALSE: update of duty cycle is done immediately (just after service call, current waveform is cut).
      integer PwmIndex: 0..4294967295, set at pre-compile, default-value=0  # Specifies the InstanceId of this module instance. If only one instance is present it shall have the Id 0.
      boolean PwmLowPowerStatesSupport: multiplicity set at pre-compile, set at pre-compile, default-value=false  # Adds / removes all power state management related APIs (PWM_SetPowerState, PWM_GetCurrentPowerState, PWM_GetTargetPowerState, PWM_PreparePowerState, PWM_Main_PowerTransitionManager), indicating if the HW offers low power state management.
      boolean PwmNotificationSupported: set at pre-compile  # Switch to indicate that the notifications are supported
      boolean PwmPeriodUpdatedEndperiod: set at pre-compile  # Switch for enabling the update of the period parameter at the end of the current period. | TRUE: update of period/duty cycle is done at the end of period of currently generated waveform (current waveform is finished). FALSE: update of period/duty cycle is done immediately (just after service call, current waveform is cut).
      boolean PwmPowerStateAsynchTransitionMode: multiplicity set at pre-compile, set at pre-compile, default-value=false  # Enables / disables support of the PWM Driver to the asynchronous power state transition.
      container PwmPowerStateConfig [0..*]  # Each instance of this parameter defines a power state and the callback to be called when this power state is reached.
        integer PwmPowerState: 0..18446744073709551615, set at pre-compile, symbolic-name-value=true  # Each instance of this parameter describes a different power state supported by the PWM HW. It should be defined by the HW supplier and used by the PWMDriver to reference specific HW configurations which set the PWM HW module in the referenced power state. | At least the power mode corresponding to full power state shall be always configured.
        function name PwmPowerStateReadyCbkRef: set at pre-compile  # Each instance of this parameter contains a reference to a power mode callback defined in a CDD or IoHwAbs component.
    container PwmChannelConfigSet  # This container contains the configuration parameters and sub containers of the AUTOSAR Pwm module.
      container PwmChannel [1..*]  # Configuration of an individual PWM channel.
        enumeration PwmChannelClass: {PWM_FIXED_PERIOD, PWM_FIXED_PERIOD_SHIFTED, PWM_VARIABLE_PERIOD, PWM_FIXED_PERIOD_CENTER_ALIGNED, PWM_FIXED_PERIOD_ZERO_SHIFTED}, multiplicity set at post-build in variant post-build / pre-compile in variant pre-compile, post-build-variant-multiplicity=true, post-build-variant-value=true, set at post-build in variant post-build / pre-compile in variant pre-compile, default-value=PWM_VARIABLE_PERIOD  # Class of PWM Channel. | ImplementationType: Pwm_ChannelClassType
        integer PwmChannelId: 0..4294967295, set at pre-compile, symbolic-name-value=true, default-value=0  # Channel Id of the PWM channel. This value will be assigned to the symbolic name derived of the PwmChannel container short name.
        integer PwmDutycycleDefault: 0..32768, post-build-variant-value=true, set at post-build in variant post-build / pre-compile in variant pre-compile, default-value=2  # Value of duty cycle used for Initialization | 0, represents 0% 0x8000 represents 100%
        float PwmDutyCycle: 0.0..100.0, post-build-variant-value=true, set at post-build in variant post-build / pre-compile in variant pre-compile, default-value=0.0  # Value of duty cycle used for Initialization. This value is an integer represents the percentage. 0, represents 0% 100, represents 100%
        float PwmDutyCycle_ms: 0..Inf, post-build-variant-value=true, set at post-build in variant post-build / pre-compile in variant pre-compile, default-value=0.0  # Value of duty cycle used for initialization in ms. This value is calculated from the Default Period and Duty Cycle percentage. It is for display only, and users cannot modify.
        integer PwmDefaultPeriod_ticks [0..1]: 0..65534, post-build-variant-value=true, set at post-build in variant post-build / pre-compile in variant pre-compile  # Default Period of the channel. Input Value in absolute ticks. This parameter does not impact the channels of class PWM_FIXED_PERIOD_SHIFTED, PWM_FIXED_PERIOD_CENTER_ALIGNED and PWM_FIXED_PERIOD_ZERO_SHIFTED. | 0, represents 0% 0x8000 represents 100%
        enumeration PwmIdleState: {PWM_HIGH, PWM_LOW}, post-build-variant-value=true, set at post-build in variant post-build / pre-compile in variant pre-compile, default-value=PWM_HIGH  # The parameter PWM_IDLE_STATE represents the output state of the PWM after the signal is stopped (e.g. call of Pwm_SetOutputToIdle).
        function name PwmNotification: multiplicity set at post-build in variant post-build / pre-compile in variant pre-compile, post-build-variant-multiplicity=true, post-build-variant-value=true, set at post-build in variant post-build / pre-compile in variant pre-compile, default-value="NULL", default-value=NULL_PTR  # Definition of the Callback function.
        integer PwmShiftValue [0..1]: 0..32768, set at pre-compile, symbolic-name-value=true, default-value=0  # FR: Shift Value for PWM_FIXED_PERIOD_SHIFTED Signal. Valid only when Channel Class is PWM_FIXED_PERIOD_SHIFTED.
        float PwmDefaultPeriod_ms: 0..Inf, post-build-variant-value=true, set at post-build in variant post-build / pre-compile in variant pre-compile, default-value=3  # Value of period used for Initialization.(in seconds).
        enumeration PwmPolarity: {HIGH, LOW}, post-build-variant-value=true, set at post-build in variant post-build / pre-compile in variant pre-compile, default-value=LOW  # Defines the starting polarity of each PWM channel.
        boolean PwmCoherentUpdate: set at pre-compile  # Setting this parameter to true determines the number of cells for a particulat class channel. PWM_VARIABLE_PERIOD = 5(true), 3 (false) PWM_FIXED_PERIOD = 4(true), 3 (true) PWM_FIXED_PERIOD_SHIFTED = 3 (true), 2 (false) PWM_FIXED_PERIOD_CENTER_ALIGNED = 4 (true), 2 (true) PWM_FIXED_PERIOD_ZERO_SHIFTED = 2 (true), Not permitted (false) | * true: enabled (ON). * false: disabled (OFF).
        reference PwmHardwareChannel: scope=ECU, post-build-variant-value=true, set at post-build in variant post-build / pre-compile in variant pre-compile, destination=LTC  # FR: The required LTC resource of a channel. Choose last LTC resource for the channel. For example PWM_FIXED_PERIOD channel class (PwmDutycycleUpdatedEndperiod is set to false): It requires three cells, if the user intends to use LTC0, LTC1 and LTC2. Assign LTC02 as the PwmAssignedHwUnit. If PwmDutycycleUpdatedEndperiod is set to true then for PWM_FIXED_PERIOD channel class, the channel needs four cells. if the user intends to use LTC0, LTC1 , LTC2 and LTC3, then assign LTC03 as PwmAssignedHwUnit.
        reference PwmReferenceChannel [0..1]: scope=ECU, post-build-variant-value=true, set at post-build in variant post-build / pre-compile in variant pre-compile, destination=PwmChannel  # FR: Reference channel for PWM_FIXED_PERIOD_SHIFTED, PWM_FIXED_PERIOD_CENTER_ALIGNED and PWM_FIXED_PERIOD_ZERO_SHIFTED channels. Reference should be a channel of PWM_FIXED_PERIOD Only.
