AUTOSAR XML (schema 4-2-2)
package /S32K144
  ecuc value collection S32K144
