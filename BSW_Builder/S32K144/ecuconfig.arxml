AUTOSAR XML (schema 4-2-2)
package /S32K144
  ecuc value collection S32K144: ecuc-values=Os
  module config Os
    OsOS:
      OsNumberOfCores = 1
      OsScalabilityClass = SC1
      OsSystemStackSize = 1024
      OsStackMonitoring = false
      OsStatus = STANDARD
      OsUseGetServiceId = false
      OsUseParameterAccess = false
      GetCPUUsage = false
      OsUseResScheduler = true
      OsHooks: OsErrorHook=false, OsPostTaskHook=false, OsPreTaskHook=false, OsShutdownHook=false, OsStartupHook=false
    OSDEFAULTAPPMODE (OsAppMode)
    Counter (OsCounter)
      SystemTimer_Core0: OsCounterMaxAllowedValue=1, OsCounterMinCycle=1, OsCounterTicksPerBase=1, OsCounterType=HARDWARE, OsSecondsPerTick=0.0
    SystemTimer: OsCpuFrequency=80000
      ArchSystemTimerCore0: OsPriority=11, OsNestedEnable=false, OsSecondsTick=0.001, OsTimerSource=SysTick_Handler
      ArchTimingProtCore0: OsTimingProtPriority=12, OsTimingProtNestedEnable=false, OsTimingProtSecondsTick=0.001, OsTimingProtTimerSource=OS_FTM0_Ch0_Ch1_IRQn
